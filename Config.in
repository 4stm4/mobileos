## Config.in
```kconfig
menu "4STM4 Mobile OS packages"

source "$BR2_EXTERNAL_MOBILEOS_PATH/packages/lvgl/Config.in"
source "$BR2_EXTERNAL_MOBILEOS_PATH/packages/mobile-shell/Config.in"
source "$BR2_EXTERNAL_MOBILEOS_PATH/packages/commd/Config.in"
source "$BR2_EXTERNAL_MOBILEOS_PATH/packages/simd/Config.in"
source "$BR2_EXTERNAL_MOBILEOS_PATH/packages/netd/Config.in"
source "$BR2_EXTERNAL_MOBILEOS_PATH/packages/telegramd/Config.in"
source "$BR2_EXTERNAL_MOBILEOS_PATH/packages/localbe/Config.in"
source "$BR2_EXTERNAL_MOBILEOS_PATH/packages/hardwared/Config.in"
source "$BR2_EXTERNAL_MOBILEOS_PATH/packages/powerd/Config.in"

endmenu
```

## packages/commd/Config.in
```kconfig
config BR2_PACKAGE_COMMD
	bool "commd — communication daemon"
	depends on BR2_PACKAGE_HOST_RUSTC
	depends on BR2_TOOLCHAIN_HAS_THREADS
	help
	  Central IPC hub exposing three Unix sockets:
	    ui.sock      (group comm-ui)      — shell, messages app
	    backend.sock (group comm-backend) — simd, telegramd, localbe
	    admin.sock   (group comm-admin)   — root/admin only
	  SO_PEERCRED verification on every accept.
	  Protocol: line-delimited JSON with envelope
	  {version, type, request_id, ts_ms, source, action, body}.
	  Backed by SQLite WAL database at /data/commd/comm.db.
```

## packages/hardwared/Config.in
```kconfig
config BR2_PACKAGE_HARDWARED
	bool "hardwared — hardware/HAT detection daemon"
	depends on BR2_PACKAGE_HOST_RUSTC
	depends on BR2_TOOLCHAIN_HAS_THREADS
	help
	  Detects attached HATs via ehatrom EEPROM (I2C ID EEPROM standard).
	  Loads per-profile kernel modules and device tree overlays.
	  Exposes hardware capabilities to other daemons.
```

## packages/localbe/Config.in
```kconfig
config BR2_PACKAGE_LOCALBE
	bool "localbe — local messaging backend"
	depends on BR2_PACKAGE_HOST_RUSTC
	depends on BR2_TOOLCHAIN_HAS_THREADS
	depends on BR2_PACKAGE_COMMD
	help
	  Local-only messaging backend; manages drafts and local threads.
	  SQLite spool at /data/spool/localbe.db.
	  Connects to commd backend.sock.
```

## packages/lvgl/Config.in
```kconfig
config BR2_PACKAGE_LVGL
	bool "LVGL — Light and Versatile Graphics Library"
	help
	  LVGL 9.2.x embedded graphics library.
	  Built as a static library; consumed by mobile-shell.
```

## packages/mobile-shell/Config.in
```kconfig
config BR2_PACKAGE_MOBILE_SHELL
	bool "mobile-shell"
	depends on BR2_PACKAGE_LVGL
	depends on BR2_TOOLCHAIN_HAS_THREADS
	depends on BR2_PACKAGE_HAS_UDEV # libinput/libudev
	select BR2_PACKAGE_LIBDRM
	select BR2_PACKAGE_LIBINPUT
	help
	  LVGL 9.x-based mobile shell: launcher, dialer,
	  messages UI, settings. Communicates via commd ui.sock.

comment "mobile-shell needs LVGL, udev /dev management and a toolchain w/ threads"
	depends on !BR2_PACKAGE_LVGL || !BR2_PACKAGE_HAS_UDEV || \
		!BR2_TOOLCHAIN_HAS_THREADS
```

## packages/netd/Config.in
```kconfig
config BR2_PACKAGE_NETD
	bool "netd — network daemon"
	depends on BR2_PACKAGE_HOST_RUSTC
	depends on BR2_TOOLCHAIN_HAS_THREADS
	select BR2_PACKAGE_WIREGUARD_TOOLS
	help
	  Network management daemon.
	  WireGuard as primary VPN; AmneziaWG as optional add-on.
	  Manages /run/netd/resolv.conf (symlinked from /etc/resolv.conf).
	  Wi-Fi via wpa_supplicant.
```

## packages/powerd/Config.in
```kconfig
config BR2_PACKAGE_POWERD
	bool "powerd — power management daemon"
	depends on BR2_PACKAGE_HOST_RUSTC
	depends on BR2_TOOLCHAIN_HAS_THREADS
	help
	  Screen dim (30s) / off (90s) via sysfs backlight.
	  Battery monitoring via sysfs power_supply.
	  Safe shutdown at 2%; alerts at 20% and 5%.
	  Unix socket at /run/powerd.sock for ACTIVITY/STATUS/SUBSCRIBE/INHIBIT.
```

## packages/simd/Config.in
```kconfig
config BR2_PACKAGE_SIMD
	bool "simd — SIM800L daemon"
	depends on BR2_PACKAGE_HOST_RUSTC
	depends on BR2_TOOLCHAIN_HAS_THREADS
	help
	  AT-command bridge to SIM800L modem.
	  Connects to commd backend.sock and exposes call/SMS/data APIs.
	  Reuses s1mB00L library for AT protocol handling.
```

## packages/tdjson/Config.in
```kconfig
config BR2_PACKAGE_TDJSON
	bool "tdjson — TDLib JSON interface library"
	depends on BR2_TOOLCHAIN_HAS_THREADS
	depends on BR2_INSTALL_LIBSTDCPP
	select BR2_PACKAGE_OPENSSL
	select BR2_PACKAGE_ZLIB
	help
	  TDLib (Telegram Database Library) built with the JSON interface.
	  Provides libtdjson.so for use by telegramd.
	  Build is CPU-intensive (~20 min on the host).
```

## packages/telegramd/Config.in
```kconfig
config BR2_PACKAGE_TELEGRAMD
	bool "telegramd — Telegram client daemon"
	depends on BR2_PACKAGE_HOST_RUSTC
	depends on BR2_TOOLCHAIN_HAS_THREADS
	depends on BR2_PACKAGE_COMMD
	help
	  Telegram integration via TDLib FFI.
	  Lazy-start: only activates when a Telegram account is provisioned.
	  Manual-media-only; light mode by default.
	  Connects to commd backend.sock.
```

## products/mobile-os/Config.in
```kconfig
menu "Mobile OS product options"

config BR2_PACKAGE_MOBILE_SHELL
	bool "mobile-shell"
	default y
	help
	  LVGL-based mobile shell — launcher, dialer, messages, settings.

config BR2_PACKAGE_COMMD
	bool "commd — communication daemon"
	default y
	help
	  Central IPC hub: ui.sock / backend.sock / admin.sock.
	  Line-delimited JSON envelope protocol with SO_PEERCRED auth.

config BR2_PACKAGE_SIMD
	bool "simd — SIM800 daemon"
	default y
	help
	  AT-command bridge to SIM800L; exposes commd backend socket API.

config BR2_PACKAGE_NETD
	bool "netd — network daemon"
	default y
	help
	  WireGuard primary + AmneziaWG add-on, DNS management.

config BR2_PACKAGE_TELEGRAMD
	bool "telegramd — Telegram client daemon (TDLib)"
	default y
	depends on BR2_PACKAGE_COMMD
	help
	  Lazy-start Telegram integration via TDLib FFI.
	  Only starts when a Telegram account is provisioned.

config BR2_PACKAGE_LOCALBE
	bool "localbe — local messaging backend"
	default y
	depends on BR2_PACKAGE_COMMD
	help
	  Draft/local-only message backend; SQLite spool.

config BR2_PACKAGE_HARDWARED
	bool "hardwared — HAT/hardware detection daemon"
	default y
	help
	  Detects attached HATs via ehatrom EEPROM; loads profiles.

config BR2_PACKAGE_POWERD
	bool "powerd — power management daemon"
	default y
	help
	  Screen dim/off, battery monitoring, safe shutdown.

endmenu
```

## products/mobile-os/configs/qemu-aarch64_defconfig
```kconfig
# Target: QEMU aarch64 virt (Cortex-A53, for development/testing)
BR2_aarch64=y
BR2_cortex_a53=y

# Toolchain
BR2_TOOLCHAIN_EXTERNAL=y
BR2_TOOLCHAIN_EXTERNAL_BOOTLIN=y
BR2_TOOLCHAIN_EXTERNAL_BOOTLIN_AARCH64_MUSL=y

# Linux kernel — upstream virt
BR2_LINUX_KERNEL=y
BR2_LINUX_KERNEL_LATEST_VERSION=y
BR2_LINUX_KERNEL_DEFCONFIG="defconfig"
BR2_LINUX_KERNEL_CONFIG_FRAGMENT_FILES="$(BR2_EXTERNAL_MOBILEOS_PATH)/board/qemu-aarch64/linux.config"
BR2_LINUX_KERNEL_IMAGE_TARGET_NAME="Image"
BR2_LINUX_KERNEL_NEEDS_HOST_OPENSSL=y

# System
BR2_TARGET_GENERIC_HOSTNAME="mobileos-qemu"
BR2_TARGET_GENERIC_ISSUE="4STM4 Mobile OS (QEMU)"
BR2_TARGET_GENERIC_ROOT_PASSWD=""

# Init system
BR2_INIT_SYSV=y

# Filesystem — raw ext4, no genimage needed for QEMU
BR2_TARGET_ROOTFS_EXT2=y
BR2_TARGET_ROOTFS_EXT2_4=y
BR2_TARGET_ROOTFS_EXT2_SIZE="512M"

# Host Rust toolchain (for Rust packages)
BR2_PACKAGE_HOST_RUSTC=y

# Base packages
BR2_PACKAGE_BUSYBOX=y
BR2_PACKAGE_LOGROTATE=y
BR2_PACKAGE_DROPBEAR=y
BR2_PACKAGE_SQLITE=y
BR2_PACKAGE_SQLITE_ENABLE_JSON=y

# Mobile OS packages (QEMU subset — no display/telephony/TDLib)
BR2_PACKAGE_COMMD=y
BR2_PACKAGE_NETD=y
BR2_PACKAGE_POWERD=y
BR2_PACKAGE_LOCALBE=y
BR2_PACKAGE_HARDWARED=y

# Disabled for QEMU (no hardware, no display)
# BR2_PACKAGE_MOBILE_SHELL is not set
# BR2_PACKAGE_SIMD is not set
# BR2_PACKAGE_TELEGRAMD is not set
# BR2_PACKAGE_TDJSON is not set
# BR2_PACKAGE_LIBDRM is not set
# BR2_PACKAGE_LVGL is not set
# BR2_PACKAGE_LIBINPUT is not set
# BR2_PACKAGE_RPI_FIRMWARE is not set

# Filesystem scripts
BR2_ROOTFS_OVERLAY="$(BR2_EXTERNAL_MOBILEOS_PATH)/board/qemu-aarch64/rootfs_overlay"
BR2_ROOTFS_POST_BUILD_SCRIPT="$(BR2_EXTERNAL_MOBILEOS_PATH)/board/qemu-aarch64/post-build.sh"
```

## products/mobile-os/configs/zero2w-phone_defconfig
```kconfig
# Target: Raspberry Pi Zero 2 W (BCM2710, ARM Cortex-A53 @ 1GHz)
BR2_aarch64=y
BR2_cortex_a53=y
BR2_ARM_FPU_NEON_FP_ARMV8=y

# Toolchain
BR2_TOOLCHAIN_EXTERNAL=y
BR2_TOOLCHAIN_EXTERNAL_BOOTLIN=y
BR2_TOOLCHAIN_EXTERNAL_BOOTLIN_AARCH64_MUSL=y

# Linux kernel
BR2_LINUX_KERNEL=y
BR2_LINUX_KERNEL_CUSTOM_GIT=y
BR2_LINUX_KERNEL_CUSTOM_REPO_URL="https://github.com/raspberrypi/linux.git"
BR2_LINUX_KERNEL_CUSTOM_REPO_VERSION="rpi-6.6.y"
BR2_LINUX_KERNEL_DEFCONFIG="bcm2711"
BR2_LINUX_KERNEL_IMAGE_TARGET_NAME="Image.gz"
BR2_LINUX_KERNEL_NEEDS_HOST_OPENSSL=y

# Boot
BR2_TARGET_ROOTFS_EXT2=y
BR2_TARGET_ROOTFS_EXT2_4=y
BR2_TARGET_ROOTFS_EXT2_SIZE="512M"
BR2_TARGET_UBOOT=n

# Raspberry Pi firmware
BR2_PACKAGE_RPI_FIRMWARE=y
BR2_PACKAGE_RPI_FIRMWARE_VARIANT_PI0_2=y
BR2_PACKAGE_RPI_FIRMWARE_CONFIG_FILE="$(BR2_EXTERNAL_MOBILEOS_PATH)/board/zero2w-phone/config.txt"

# System
BR2_TARGET_GENERIC_HOSTNAME="mobileos"
BR2_TARGET_GENERIC_ISSUE="4STM4 Mobile OS"
BR2_SYSTEM_DHCP="eth0"
BR2_TARGET_GENERIC_ROOT_PASSWD=""

# Init system
BR2_INIT_SYSV=y

# Base packages
BR2_PACKAGE_BUSYBOX=y
BR2_PACKAGE_BUSYBOX_CONFIG="$(BR2_EXTERNAL_MOBILEOS_PATH)/board/zero2w-phone/busybox.config"
BR2_PACKAGE_DROPBEAR=y
BR2_PACKAGE_SQLITE=y
BR2_PACKAGE_SQLITE_ENABLE_JSON=y

# Mobile OS packages
BR2_PACKAGE_MOBILE_SHELL=y
BR2_PACKAGE_COMMD=y
BR2_PACKAGE_SIMD=y
BR2_PACKAGE_NETD=y
BR2_PACKAGE_TELEGRAMD=y
BR2_PACKAGE_LOCALBE=y
BR2_PACKAGE_HARDWARED=y
BR2_PACKAGE_POWERD=y

# Filesystem overlay
BR2_ROOTFS_OVERLAY="$(BR2_EXTERNAL_MOBILEOS_PATH)/board/zero2w-phone/rootfs_overlay"
BR2_ROOTFS_POST_BUILD_SCRIPT="$(BR2_EXTERNAL_MOBILEOS_PATH)/board/zero2w-phone/post-build.sh"
BR2_ROOTFS_POST_IMAGE_SCRIPT="$(BR2_EXTERNAL_MOBILEOS_PATH)/board/zero2w-phone/post-image.sh"
```
